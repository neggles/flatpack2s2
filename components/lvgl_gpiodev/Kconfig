## components/lvgl_gpiodev/Kconfig
```kconfig
menu "LVGL GPIO indev pins"

    config SW_L_GPIO
        int "Button 3 (SW_L) GPIO"
        default 35
        help
            Selects GPIO for SW3 (SW_L)

    config SW_S_GPIO
        int "Button 4 (SW_S) GPIO"
        default 36
        help
            Selects GPIO for SW4 (SW_S)

    config SW_R_GPIO
        int "Button 5 (SW_R) GPIO"
        default 37
        help
            Selects GPIO for SW5 (SW_R)

    config SW_B_GPIO
        int "Button 1 (SW_B/BOOT) GPIO"
        default 0
        help
            Selects GPIO for SW1 (SW_B/BOOT) which is used for BACK while running.
            NOTE: This does not affect hardware handling of GPIO0, but it does allow assigning a different GPIO
            to the BACK function in the app.

endmenu # flatpack2s2 Project Configuration
```

## main/Kconfig
```kconfig
menu "flatpack2s2 Project Configuration"

    menu "System"

        config SNTP_SERVER
            string "SNTP Server address/hostname"
            default "pool.ntp.org"
            help
                Set default SNTP server used by library if one is not provided by DHCP

        config POSIX_TZ
            string "POSIX Time Zone String"
            default "AEST-10AEDT,M10.1.0,M4.1.0/3"
            help
                POSIX time zone string for system. I might implement a tz db later idk

    endmenu #System

    menu "TWAI"

        config TWAI_TX_GPIO
            int "TWAI TX GPIO"
            default 15
            help
                Selects GPIO used for TWAI (CAN) bus transmit. Connect to your CAN transceiver's TX pin.

        config TWAI_RX_GPIO
            int "TWAI RX GPIO"
            default 16
            help
                Selects GPIO used for TWAI (CAN) bus receive. Connect to your CAN transceiver's RX pin.

        config TWAI_EN_GPIO
            int "TWAI transceiver enable GPIO"
            default 17
            help
                Selects GPIO used for TWAI (CAN) bus transceiver enable. Connect to your CAN transciever.

        config TWAI_EN_ACTIVE_LOW
            bool "TWAI_EN output state when transceiver is active"
            default y
            help
                Most transceiver enable pins are active-low - if yours is active-high, uncheck this box.

        config TWAI_USE_FP2_FILTER
            bool "Enable flatpack2 TWAI message filter"
            default n
            help
                When enabled, the TWAI driver will filter out TWAI/CAN messages whose IDs do not match 0x05xxxxxx.
                Enable if the PSU/controller are sharing the bus with other devices.

        config TWAI_EN_ACTIVE_STATE
            int
            default 0 if TWAI_EN_ACTIVE_LOW=y
            default 1 if TWAI_EN_ACTIVE_LOW=n

    endmenu #TWAI

    menu "I2C"

        config I2C_QWIIC_SCL
            int "Qwiic Connector SCL GPIO"
            default 1
            help
                Selects GPIO used for Qwiic connector SCL line

        config I2C_QWIIC_SDA
            int "Qwiic Connector SDA GPIO"
            default 2
            help
                Selects GPIO used for Qwiic connector SDA line

    endmenu #I2C

    menu "flatpack2"

        config FP2_VOUT_MIN
            int "Flatpack2 PSU rated minimum voltage"
            default 4350
            help
                Enter your power supply's rated minimum voltage, in centiVolts (Volts * 100).

        config FP2_VOUT_MAX
            int "Flatpack2 PSU rated maximum voltage"
            default 5760
            help
                Enter your power supply's rated maximum voltage, in centiVolts (Volts * 100).

        config FP2_VOUT_OVP
            int "Flatpack2 PSU over-voltage protection setpoint"
            default 5950
            help
                Level to set for PSU over-voltage protection, in centiVolts (Volts * 100).
                Typically 1.5-2V higher than rated maximum voltage.

        config FP2_IOUT_MAX
            int "Flatpack2 PSU rated maximum current"
            default 417
            help
                Enter your power supply's rated maximum current, in deciAmps (Amps * 10)

    endmenu #flatpack2

    menu "misc. GPIOs"

        config RGB_GPIO
            int "WS2812B RGB LED GPIO"
            default 38
            help
                Selects GPIO used for WS2812B RGB status LED

    endmenu #misc. GPIOs

endmenu # flatpack2s2
```

## main/Kconfig.projbuild
```kconfig
menu "flatpack2s2 Project Configuration"

    menu "System"

        config SNTP_SERVER
            string "SNTP Server address/hostname"
            default "pool.ntp.org"
            help
                Set default SNTP server used by library if one is not provided by DHCP

        config POSIX_TZ
            string "POSIX Time Zone String"
            default "AEST-10AEDT,M10.1.0,M4.1.0/3"
            help
                POSIX time zone string for system. I might implement a tz db later idk

        config MDNS_HOST_NAME
            default "flatpack2s2"
            help
                Specify the hostname to advertise over mDNS; this affects the expected hostname of the web API.
                Should be set the same as CONFIG_LWIP_LOCAL_HOSTNAME

        choice WEB_DEPLOY_MODE
            prompt "Web interface deployment mode"
            default WEB_DEPLOY_FLASH
            help
                Select website deploy mode.
                You can deploy website to host, and ESP32 will retrieve them in a semihost way (JTAG is needed).
                You can deploy website to SD card or SPI flash, and ESP32 will retrieve them via SDIO/SPI interface.
                Detailed operation steps are listed in the example README file.
            config WEB_DEPLOY_FLASH
                bool "Flash partition"
                help
                    Deploy web frontend files to fatfs partition on SPI flash.
                    Recommended for production use, limits total web filesize.
            config WEB_DEPLOY_SEMIHOST
                bool "Semihosting"
                help
                    Deploy using JTAG/GDB filesystem semihosting mode.
                    Recommended during development, if you have JTAG available - will not work otherwise.
        endchoice

        if WEB_DEPLOY_SEMIHOST
        config HOST_PATH_TO_MOUNT
            string "Host path to mount (e.g. absolute path to web dist directory)"
            default "PATH-TO-WEB-DIST_DIR"
            help
                Absolute path on host to mount in web file semihosting mode.
        endif

        config WEB_MOUNT_POINT
            string "Web VFS mount point"
            default "/www"
            help
                Path under which web files will be mounted in ESP VFS.
                You shouldn't need to change this, really, and if you do it may break things.
    endmenu #System

    menu "TWAI"

        config TWAI_TX_GPIO
            int "TWAI TX GPIO"
            default 15
            help
                Selects GPIO used for TWAI (CAN) bus transmit. Connect to your CAN transceiver's TX pin.

        config TWAI_RX_GPIO
            int "TWAI RX GPIO"
            default 16
            help
                Selects GPIO used for TWAI (CAN) bus receive. Connect to your CAN transceiver's RX pin.

        config TWAI_EN_GPIO
            int "TWAI transceiver enable GPIO"
            default 17
            help
                Selects GPIO used for TWAI (CAN) bus transceiver enable. Connect to your CAN transciever.

        config TWAI_EN_ACTIVE_LOW
            bool "TWAI_EN output state when transceiver is active"
            default y
            help
                Most transceiver enable pins are active-low - if yours is active-high, uncheck this box.

        config TWAI_USE_FP2_FILTER
            bool "Enable flatpack2 TWAI message filter"
            default n
            help
                When enabled, the TWAI driver will filter out TWAI/CAN messages whose IDs do not match 0x05xxxxxx.
                Enable if the PSU/controller are sharing the bus with other devices.

        config TWAI_EN_ACTIVE_STATE
            int
            default 0 if TWAI_EN_ACTIVE_LOW=y
            default 1 if TWAI_EN_ACTIVE_LOW=n

    endmenu #TWAI

    menu "I2C"

        config I2C_QWIIC_SCL
            int "Qwiic Connector SCL GPIO"
            default 1
            help
                Selects GPIO used for Qwiic connector SCL line

        config I2C_QWIIC_SDA
            int "Qwiic Connector SDA GPIO"
            default 2
            help
                Selects GPIO used for Qwiic connector SDA line

    endmenu #I2C

    menu "flatpack2"

        config FP2_VOUT_MIN
            int "Flatpack2 PSU rated minimum voltage"
            default 4350
            help
                Enter your power supply's rated minimum voltage, in centiVolts (Volts * 100).

        config FP2_VOUT_MAX
            int "Flatpack2 PSU rated maximum voltage"
            default 5760
            help
                Enter your power supply's rated maximum voltage, in centiVolts (Volts * 100).

        config FP2_VOUT_OVP
            int "Flatpack2 PSU over-voltage protection setpoint"
            default 5950
            help
                Level to set for PSU over-voltage protection, in centiVolts (Volts * 100).
                Typically 1.5-2V higher than rated maximum voltage.

        config FP2_IOUT_MAX
            int "Flatpack2 PSU rated maximum current"
            default 417
            help
                Enter your power supply's rated maximum current, in deciAmps (Amps * 10)

    endmenu #flatpack2

    menu "misc. GPIOs"

        config RGB_GPIO
            int "WS2812B RGB LED GPIO"
            default 38
            help
                Selects GPIO used for WS2812B RGB status LED

    endmenu #misc. GPIOs

endmenu # flatpack2s2
```
